## main/Kconfig.projbuild
```kconfig
menu "OTA demo"

    config OTA_DEMO_URL
        string "GitHub Release firmware URL"
        default "https://github.com/DEIN-KONTO/DEIN-REPO/releases/latest/download/firmware.bin"

endmenu
```

## sdkconfig.defaults
```kconfig
CONFIG_ESPTOOLPY_FLASHSIZE_4MB=y
CONFIG_PARTITION_TABLE_CUSTOM=y
CONFIG_PARTITION_TABLE_CUSTOM_FILENAME="partitions.csv"
CONFIG_SECURE_SIGNED_APPS_NO_SECURE_BOOT=y
CONFIG_SECURE_SIGNED_APPS_ECDSA_SCHEME=y
CONFIG_SECURE_SIGNED_ON_UPDATE_NO_SECURE_BOOT=y
CONFIG_SECURE_BOOT_BUILD_SIGNED_BINARIES=y
CONFIG_SECURE_BOOT_SIGNING_KEY="keys/ota-signing-key.pem"
CONFIG_MBEDTLS_CERTIFICATE_BUNDLE=y
CONFIG_LOG_DEFAULT_LEVEL_NONE=y
```
